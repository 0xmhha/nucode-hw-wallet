## CMakeLists.txt
```
cmake_minimum_required(VERSION 3.20.0)
find_package(Zephyr REQUIRED HINTS $ENV{ZEPHYR_BASE})
project(nuwallet)

# 암호 스택은 Arduino 스케치(../nuwallet)와 공유한다. 한 곳에만 둔다.
set(SHARED ${CMAKE_CURRENT_SOURCE_DIR}/../nuwallet/src)

target_sources(app PRIVATE
    src/main.c

    src/app/framing.c
    src/app/rlp.c
    src/app/store.c
    src/app/wallet.c

    src/port/zephyr/hal_zephyr.c
    src/port/zephyr/ble.c

    ${SHARED}/crypto/sha2.c
    ${SHARED}/crypto/hmac.c
    ${SHARED}/crypto/keccak.c
    ${SHARED}/crypto/bip39.c
    ${SHARED}/crypto/bip32.c
    ${SHARED}/crypto/ecdsa.c

    ${SHARED}/micro-ecc/uECC.c
)

target_include_directories(app PRIVATE src ${SHARED})

# micro-ecc 는 플랫폼 매크로가 없으면 인라인 어셈블리를 고른다.
# Cortex-M4 에서는 그쪽이 빠르지만, 빌드가 깨지면 아래를 켜서 C 로 떨어뜨린다.
# target_compile_definitions(app PRIVATE uECC_PLATFORM=uECC_arch_other)
```

## prj.conf
```kconfig
# ── BLE ──────────────────────────────────────────────────────────────────
CONFIG_BT=y
CONFIG_BT_PERIPHERAL=y
CONFIG_BT_DEVICE_NAME="NuWallet"
CONFIG_BT_DEVICE_NAME_DYNAMIC=y
CONFIG_BT_DEVICE_NAME_MAX=24
CONFIG_BT_MAX_CONN=1
CONFIG_BT_MAX_PAIRED=4

# 본딩 필수. 페어링 없이 들어온 연결은 특성 권한에서 막힌다 (SECURITY.md §4).
CONFIG_BT_SMP=y
CONFIG_BT_SMP_SC_PAIR_ONLY=y
CONFIG_BT_BONDABLE=y
CONFIG_BT_SETTINGS=y

# 니모닉(최대 49바이트)과 트랜잭션 RLP 를 몇 패킷 안에 보내려면 MTU 를 키운다.
CONFIG_BT_L2CAP_TX_MTU=247
CONFIG_BT_BUF_ACL_RX_SIZE=251
CONFIG_BT_BUF_ACL_TX_SIZE=251
CONFIG_BT_CTLR_DATA_LENGTH_MAX=251
CONFIG_BT_GATT_CLIENT=n

# ── 저장 ─────────────────────────────────────────────────────────────────
CONFIG_FLASH=y
CONFIG_FLASH_MAP=y
CONFIG_NVS=y
CONFIG_SETTINGS=y
CONFIG_SETTINGS_NVS=y

# ── 난수 ─────────────────────────────────────────────────────────────────
CONFIG_ENTROPY_GENERATOR=y
CONFIG_CSPRNG_ENABLED=y
CONFIG_HARDWARE_DEVICE_CS_GENERATOR=y

# ── 주변장치 ─────────────────────────────────────────────────────────────
CONFIG_GPIO=y
CONFIG_HWINFO=y

# ── 크기·스택 ────────────────────────────────────────────────────────────
# PBKDF2-HMAC-SHA512 2048회(BIP-39)와 4096회(레코드 키)를 메인 스택에서 돌린다.
CONFIG_MAIN_STACK_SIZE=8192
CONFIG_SYSTEM_WORKQUEUE_STACK_SIZE=2048
CONFIG_HEAP_MEM_POOL_SIZE=2048

CONFIG_LOG=y
CONFIG_LOG_MODE_DEFERRED=y

# 개인키가 스택에 남는다. 함수를 빠져나갈 때 지우고 있지만, 컴파일러가
# memset 을 지우지 못하게 최적화 수준을 낮춰 둔다.
CONFIG_SPEED_OPTIMIZATIONS=y
```

## src/main.c
```c
/* NuWallet — nRF52840 하드웨어 지갑 펌웨어 (Zephyr).
 *
 * 하는 일은 셋뿐이다.
 *   1. HAL 과 BLE 를 올린다
 *   2. 버튼 입력을 코어에 넘긴다
 *   3. 10ms 마다 코어를 틱 시킨다 (타임아웃 · LED)
 *
 * 프로토콜 처리는 전부 app/wallet.c 에 있다. 그쪽은 Zephyr 를 모른다.     */
#include <zephyr/kernel.h>
#include <zephyr/logging/log.h>

#include "app/wallet.h"
#include "port/zephyr/hal_zephyr.h"
#include "port/zephyr/ble.h"

LOG_MODULE_REGISTER(nuwallet, LOG_LEVEL_INF);

static nu_hal    hal;
static nu_wallet wallet;
static char      name[24];

/* 버튼은 워크큐 컨텍스트에서 온다. 코어는 재진입을 가정하지 않으므로
 * 메시지 큐로 넘겨 메인 루프 한 곳에서만 만진다. */
K_MSGQ_DEFINE(btn_q, sizeof(uint8_t), 8, 1);

static void on_button(uint8_t idx) {
    k_msgq_put(&btn_q, &idx, K_NO_WAIT);
}

int main(void) {
    if (nu_zephyr_hal_init(&hal)) {
        LOG_ERR("HAL 초기화 실패 — 멈춥니다");
        return 0;
    }
    nu_zephyr_set_button_cb(on_button);

    /* BLE 를 먼저 올려야 hal.send 가 채워진다. 이름도 여기서 정해진다. */
    nu_wallet_init(&wallet, &hal, "NuWallet");
    if (nu_ble_start(&wallet, &hal, name, sizeof name)) {
        LOG_ERR("BLE 시작 실패 — 멈춥니다");
        return 0;
    }
    /* 광고 이름이 정해진 뒤 코어를 다시 초기화해 GET_VERSION 이 같은 이름을
     * 돌려주게 한다. 플래시 레코드도 이때 다시 읽힌다. */
    nu_wallet_init(&wallet, &hal, name);

    LOG_INF("NuWallet 준비됨 (%s)", name);

    for (;;) {
        uint8_t idx;
        while (k_msgq_get(&btn_q, &idx, K_NO_WAIT) == 0) {
            nu_wallet_button(&wallet, idx);
        }
        nu_wallet_tick(&wallet, k_uptime_get_32());
        k_sleep(K_MSEC(10));
    }
    return 0;
}
```
